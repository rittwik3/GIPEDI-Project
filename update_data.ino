/*The circuit:
 * SD card attached to SPI bus as follows:
 ** MOSI - pin 11
 ** MISO - pin 12
 ** CLK - pin 13
 ** CS - pin 4
 
 
 
 
 
 
 
 //////////////////////////////////////////////////////
 DEFINE
 /////////////////////////////////////////////////////
 SD Card- Secure Digital Card
 MOSI- Master Out Slave In
 MISO- Master In Slave Out
 CS- Chip Select
 CLK- Clock
 SCK- Serial Clock
 ///////////////////////////////////////////////////
 
 
 a) MOSI signal is generated by Master, recipient is Slave
 b) Slaves generate MISO signals and recipient is Master
 c) SCK- SCLK signal is generated by Master to synchronize data transfers between the master and the Slave
 d) SS - (Slave Select) from Master to CS of Slave--- SS signal is generated by Master to select individuals slave devices. The CS is an active low signal


//////////////////////////////////////////////// 
*/



#include <SD.h>

File myFile;
File Track;
const int chipSelect=4;
void setup()
{
 // Open serial communications and wait for port to open:
  Serial.begin(9600);
   while (!Serial) {
    ; // wait for serial port to connect.
  }


  Serial.print("Initializing SD card...");
  // On the Ethernet Shield, CS is pin 4. It's set as an output by default.
  // Note that even if it's not used as the CS pin, the hardware SS pin 
  // (10 on most Arduino boards, 53 on the Mega) must be left as an output 
  // or the SD library functions will not work. 
  pinMode(10, OUTPUT);


  /* if chipSelect pin is not selcted
     SD card won't be accessible*/
  if (!SD.begin(4)) {
    Serial.println("initialization failed!");
    return;
  }
  Serial.println("initialization done.");


  // check the existence of file
  if (SD.exists("tourist.txt")) {
    Serial.println("tourist.txt exists.");
  }
  else {
    Serial.println("tourist.txt doesn't exist.");
  }



  // delete the file:
  Serial.println("Removing previous database...");
  SD.remove("tourist.txt");
  
  
  // check the existence of file
  if (SD.exists("tourist.txt")){ 
    Serial.println("tourist.txt exists.");
  }
  else {
    Serial.println("tourist.txt doesn't exist.");  
  }


// create and write to the new file
 Serial.println("Creating new database file ...");
   File Track = SD.open("tourist.txt", FILE_WRITE);
  
// START NEW DATABASE FILE
 if (Track) {
    
    Serial.print("Writing to new data base file...");
    Track.println("         Tourist Database       ");
	
    Track.close();
    Serial.println("done.");
 }

}

void loop()
{
  // nothing happens after setup finishes.
}


