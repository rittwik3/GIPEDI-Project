/*The circuit:
 * SD card attached to SPI bus as follows:
 ** MOSI - pin 11
 ** MISO - pin 12
 ** CLK - pin 13
 ** CS - pin 4
 
 
 
 
 
 
 
 //////////////////////////////////////////////////////
 DEFINE
 /////////////////////////////////////////////////////
 SD Card- Secure Digital Card
 MOSI- Master Out Slave In
 MISO- Master In Slave Out
 CS- Chip Select
 CLK- Clock
 SCK- Serial Clock
 ///////////////////////////////////////////////////
 
 
 a) MOSI signal is generated by Master, recipient is Slave
 b) Slaves generate MISO signals and recipient is Master
 c) SCK- SCLK signal is generated by Master to synchronize data transfers between the master and the Slave
 d) SS - (Slave Select) from Master to CS of Slave--- SS signal is generated by Master to select individuals slave devices. The CS is an active low signal


//////////////////////////////////////////////// 



 temperature measuring : Achieved by LM35 
*/ 

#include <SD.h>
#include <SoftwareSerial.h>


// Include SD and SOftware Serial libraries


const int chipSelect = 4;
#define rxPin 8
#define txPin 9


// rxPin: Receiver pin for Software Serial communication
// txPin: Transmitter pin for Software Serial communication


// *** Declaration of Software Serial Port***
SoftwareSerial b(rxPin, txPin);

float tempC;
int reading;
int tempPin = 0;



// temperature measuring pin = A0 of arduino (DIGITAL_PIN)


void Write(String);
void setup()
{

  
  pinMode(rxPin, INPUT);  
  pinMode(txPin, OUTPUT);
  analogReference(INTERNAL);


// reading temperature//


reading = analogRead(tempPin);
tempC = reading / 9.31;       // 9.31 is calibration factor
 
 
 /* temperature sensor LM35 
  when see from lateral side upside
 
  left: vcc (+5V)
  center: vout (output voltage(in V))
  right: gnd (0V)
 
  here vout is (A0 pin) else, we could take any pin.
 */
 
 
 
 // Start Serial Port Communication at baud rate : 9600 symbols/sec
  Serial.begin(9600);
  
   while (!Serial) {
    ; 
  }

  Serial.print("Initializing SD card...");
 
  
  // *********** Initianisation of Sofware Serial port at baud rate : 9600 symbols/sec ***************
  b.begin(9600);
  b.println("Initialisation begin");
  
  
  /* if chipSelect pin is not selcted
     SD card won't be accessible*/
     
  if (!SD.begin(chipSelect)) {
    Serial.println("Card failed, or not present");
    return;
  }
  
  
  Serial.println("card initialized.");
  
 Serial.println("Hello, I was compiled " __DATE__ );
 
  // Declaration of Database File 
  File Mfile;
  File dataFile = SD.open("test.txt");

  
  
  ////////////////////////////////* Writing on Serial Monitor content of database file *///////////////////////////////
  if (dataFile) {
    
    while (dataFile.available()) {
      Serial.write(dataFile.read());
           
    }
    
    ///////////////// printing temperature on app (Writing on SoftwareSerial port) 
     b.write("Voila !!  Today's Temperature is :  ");
     b.println(tempC);
    dataFile.close();
  }  
  
  else {
    Serial.println("error opening datalog.txt");
  }
 
 File myFile=SD.open("test.txt");
 
 /* Displaying Contents of datbase on App*/
 
 while (myFile.available()) {
      
        b.write(myFile.read());

      
    }
    
    
 myFile.close(); 
 
 
 
Mfile = SD.open("tourist.txt", FILE_WRITE);
  
  
                        if(Mfile)
                        {
                          Serial.println("Hello jo ");
                                                             
                          Mfile.close();
                          Serial.println("done");
                        }
  
  
  
  Mfile = SD.open("tourist.txt");
                                                if (Mfile) {
                                                  Serial.println("tourist.txt");
                                                  
                                                  // read from the file until there's nothing else in it:
                                                  while (Mfile.available()) {
                                                  	Serial.write(Mfile.read());
                                                  }
                                                  // close the file:
                                                  Mfile.close();
                                                } else {
                                                	// if the file didn't open, print an error:
                                                  Serial.println("error opening tourist.txt");
                                                }
  





Serial.print("Voila Today temp. is:  ");
Serial.println(tempC);


//b.println(tempC);

}

void loop()
{
  
  /* TOURIST TRACKING
     Recieve data from app containg name of tourists : STORES IN TOURIST TRACK FILE   */
     
  if( b.available()){
    String incomingByte = b.readString();
    Serial.println(incomingByte);
    Write(incomingByte);
   
  }


}

void Write(String incomingByte)
{
File myFile;
myFile=SD.open("tourist.txt" , FILE_WRITE);
if(myFile)
                        {
                          myFile.println(incomingByte);                      
                          myFile.close();
                          Serial.println("done");
                        }

}
